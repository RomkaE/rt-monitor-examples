## esp8266/sdkconfig.defaults
```kconfig
CONFIG_ESPTOOLPY_BAUD_921600B=y

CONFIG_FREERTOS_GENERATE_RUN_TIME_STATS=y
CONFIG_FREERTOS_GENERATE_REAL_TIME_STATS=y
# CONFIG_FREERTOS_RUN_TIME_STATS_USING_ESP_TIMER is not set
CONFIG_FREERTOS_RUN_TIME_STATS_USING_CPU_CLK=y
```
